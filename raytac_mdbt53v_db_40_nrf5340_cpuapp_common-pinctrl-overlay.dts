/dts-v1/;
/plugin/;

/ {
  compatible = "raytac,gms-nrf5340-cpuapp";

  &pinctrl {
    uart0_default: uart0_default {
      group1 {
        psels = <NRF_PSEL(UART_TX, 1, 2)>,
                <NRF_PSEL(UART_RX, 0, 3)>,
      };
    };

	uart0_sleep: uart0_sleep {
		group1 {
        psels = <NRF_PSEL(UART_TX, 1, 2)>,
                <NRF_PSEL(UART_RX, 0, 3)>,
			low-power-enable;
		};
	};

    /* 다른 pinctrl 그룹들... */
  };

  /* 필요한 경우 다른 노드들... */
};
